AUTOSAR XML (schema 00049)
package /Components/SwcImplementations
  swc implementation PrkgClimaActvMgr_Impl: programming-language=C, sw-version=1.14.1, used-code-generator=Embedded Coder 7.9 (R2022b) 13-May-2022, vendor-id=0, behavior=PrkgClimaActvMgr_IB
    code-descriptors:
      code Code
        artifact-descriptors:
          short-label=PrkgClimaActvMgr_c, category=SWSRC
          short-label=PrkgClimaActvMgr_h, category=SWHDR
          short-label=PrkgClimaActvMgr_private_h, category=SWHDR
          short-label=PrkgClimaActvMgr_types_h, category=SWHDR
          short-label=rtwtypes_h, category=SWHDR
    resource consumption RsrcCons_PrkgClimaActvMgr
