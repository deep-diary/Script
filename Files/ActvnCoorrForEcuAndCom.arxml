AUTOSAR XML (schema 00049)
package /Components
  application sw component type ActvnCoorrForEcuAndCom
    behavior ActvnCoorrForEcuAndCom_IB: handle-termination-and-restart=NO-SUPPORT
      init event Event_ActvnCoorrForEcuAndCom_Init: start-on-event=ActvnCoorrForEcuAndCom_Init
      timing event Event_ActvnCoorrForEcuAndCom_Runnable: start-on-event=ActvnCoorrForEcuAndCom_Runnable, period=0.1
      runnable ActvnCoorrForEcuAndCom_Init
      runnable ActvnCoorrForEcuAndCom_Runnable
package /Components/SwcImplementations
  swc implementation ActvnCoorrForEcuAndCom_Impl: programming-language=C, sw-version=1.6.1, used-code-generator=Embedded Coder 7.9 (R2022b) 13-May-2022, vendor-id=0, behavior=ActvnCoorrForEcuAndCom_IB
    code-descriptors:
      code Code
        artifact-descriptors:
          short-label=ActvnCoorrForEcuAndCom_c, category=SWSRC
          short-label=ActvnCoorrForEcuAndCom_h, category=SWHDR
          short-label=ActvnCoorrForEcuAndCom_private_h, category=SWHDR
          short-label=ActvnCoorrForEcuAndCom_types_h, category=SWHDR
          short-label=rtwtypes_h, category=SWHDR
    resource consumption RsrcCons_ActvnCoorrForEcuAndCom
package /DataTypes/SwAddrMethods
  sw addr method CODE: section-type=CODE
  sw addr method CONST: section-type=CONST
  sw addr method VAR: section-type=VAR
