AUTOSAR XML (schema 00049)
package /Components
  application sw component type AirDirecCtrlMgr
    behavior AirDirecCtrlMgr_IB: handle-termination-and-restart=NO-SUPPORT
      init event Event_AirDirecCtrlMgr_Init: start-on-event=AirDirecCtrlMgr_Init
      timing event Event_AirDirecCtrlMgr_Runnable: start-on-event=AirDirecCtrlMgr_Runnable, period=0.2
      runnable AirDirecCtrlMgr_Init
      runnable AirDirecCtrlMgr_Runnable
package /Components/SwcImplementations
  swc implementation AirDirecCtrlMgr_Impl: programming-language=C, sw-version=1.6.1, used-code-generator=Embedded Coder 7.9 (R2022b) 13-May-2022, vendor-id=0, behavior=AirDirecCtrlMgr_IB
    code-descriptors:
      code Code
        artifact-descriptors:
          short-label=AirDirecCtrlMgr_c, category=SWSRC
          short-label=AirDirecCtrlMgr_h, category=SWHDR
          short-label=AirDirecCtrlMgr_private_h, category=SWHDR
          short-label=AirDirecCtrlMgr_types_h, category=SWHDR
          short-label=rtwtypes_h, category=SWHDR
    resource consumption RsrcCons_AirDirecCtrlMgr
package /DataTypes/SwAddrMethods
  sw addr method CODE: section-type=CODE
  sw addr method CONST: section-type=CONST
  sw addr method VAR: section-type=VAR
