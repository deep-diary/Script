AUTOSAR XML (schema 00049)
package /Components
  application sw component type PrkgClimaActvMgr
    behavior PrkgClimaActvMgr_IB: handle-termination-and-restart=NO-SUPPORT
      init event Event_Init: start-on-event=PrkgClimaActvMgr_Init
      timing event Event_Runnable: start-on-event=PrkgClimaActvMgr_Runnable, period=0.2
      runnable PrkgClimaActvMgr_Init
      runnable PrkgClimaActvMgr_Runnable
